## dts/bindings/behaviors/daily-reset.yaml
```yaml
# Copyright (c) 2024 The ZMK Contributors
# SPDX-License-Identifier: MIT

description: Reset daily key counter to zero
compatible: "zmk,behavior-daily-reset"
```

## dts/bindings/behaviors/total-reset.yaml
```yaml
# Copyright (c) 2024 The ZMK Contributors
# SPDX-License-Identifier: MIT

description: Reset total key counter to zero
compatible: "zmk,behavior-total-reset"
```
